## sdkconfig.defaults
```kconfig
CONFIG_BSP_BOARD_ESP32_S3_BOX_3=y

CONFIG_FREERTOS_HZ=1000
CONFIG_AUTOSTART_ARDUINO=y

# CONFIG_MBEDTLS_SSL_CLI_C=y
CONFIG_MBEDTLS_PSK_MODES=y
CONFIG_MBEDTLS_KEY_EXCHANGE_PSK=y
CONFIG_MBEDTLS_KEY_EXCHANGE_ECDHE_PSK=y
CONFIG_MBEDTLS_KEY_EXCHANGE_RSA_PSK=y

# Enable Bluetooth
CONFIG_BT_ENABLED=y
CONFIG_BT_NIMBLE_ENABLED=y
CONFIG_BT_BLUEDROID_ENABLED=n

# Use NimBLE in central role (so you can scan and connect to keyboards)
CONFIG_BT_NIMBLE_ROLE_CENTRAL=y
CONFIG_BT_NIMBLE_ROLE_OBSERVER=y
CONFIG_BT_NIMBLE_ROLE_PERIPHERAL=n

# Optional: HID and persistence
# CONFIG_BT_NIMBLE_SVC_HID_SERVICE=y
CONFIG_BT_NIMBLE_NVS_PERSIST=y
CONFIG_BT_NIMBLE_GATT_CLIENT=y
CONFIG_BT_NIMBLE_DEBUG=y

# CONFIG_LVGL_ENABLE=y
CONFIG_LV_COLOR_16_SWAP=y
# CONFIG_LV_COLOR_DEPTH_16=y
```
